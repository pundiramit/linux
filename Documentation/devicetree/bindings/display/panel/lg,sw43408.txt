## Documentation/devicetree/bindings/soundwire/bus.txt
```
SoundWire bus bindings.

SoundWire is a 2-pin multi-drop interface with data and clock line.
It facilitates development of low cost, efficient, high performance systems.

SoundWire controller bindings are very much specific to vendor.

Child nodes(SLAVE devices):
Every SoundWire controller node can contain zero or more child nodes
representing slave devices on the bus. Every SoundWire slave device is
uniquely determined by the enumeration address containing 5 fields:
SoundWire Version, Instance ID, Manufacturer ID, Part ID and Class ID
for a device. Addition to below required properties, child nodes can
have device specific bindings.

Required property for SoundWire child node if it is present:
- compatible:	 "sdwVER,MFD,PID,CID". The textual representation of
		  SoundWire Enumeration address comprising SoundWire
		  Version, Manufacturer ID, Part ID and Class ID,
		  shall be in lower-case hexadecimal with leading
		  zeroes suppressed.
		  Version number '0x10' represents SoundWire 1.0
		  Version number '0x11' represents SoundWire 1.1
		  ex: "sdw10,0217,2010,0"

- sdw-instance-id: Should be ('Instance ID') from SoundWire
		  Enumeration Address. Instance ID is for the cases
		  where multiple Devices of the same type or Class
		  are attached to the bus.

SoundWire example for Qualcomm's SoundWire controller:

soundwire@c2d0000 {
	compatible = "qcom,soundwire-v1.5.0"
	reg = <0x0c2d0000 0x2000>;

	spkr_left:wsa8810-left{
		compatible = "sdw10,0217,2010,0";
		sdw-instance-id = <1>;
		...
	};

	spkr_right:wsa8810-right{
		compatible = "sdw10,0217,2010,0";
		sdw-instance-id = <2>;
		...
	};
};
```

## Documentation/devicetree/bindings/soundwire/qcom,sdw.txt
```
Qualcomm SoundWire Controller

This binding describes the Qualcomm SoundWire Controller Bindings.

Required properties:

- compatible:		Must be "qcom,soundwire-v<MAJOR>.<MINOR>.<STEP>",
	 		example:
			"qcom,soundwire-v1.3.0"
			"qcom,soundwire-v1.5.0"
			"qcom,soundwire-v1.6.0"
- reg:			SoundWire controller address space.
- interrupts:		SoundWire controller interrupt.
- clock-names:		Must contain "iface".
- clocks:		Interface clocks needed for controller.
- #sound-dai-cells:	Must be 1 for digital audio interfaces on the controllers.
- #address-cells:	Must be 1 for SoundWire devices;
- #size-cells:		Must be <0> as SoundWire addresses have no size component.
- qcom,dout-ports: 	Must be count of data out ports
- qcom,din-ports: 	Must be count of data in ports
- qcom,ports-offset1:	Must be payload transport window offset1 of each data port.
			Out followed by In. Used for Block size calculation.
- qcom,ports-offset2: 	Must be payload transport window offset2 of each data port.
			Out followed by In. Used for Block size calculation.
- qcom,ports-sinterval-low: Must be sample interval low of each data port.
			Out followed by In. Used for Sample Interval calculation.
- qcom,ports-hstart:	Must be number identifying lowerst numbered coloum in
			SoundWire Frame, ie left edge of the Transport sub-frame
			for each port. Values between 0 and 15 are valid
			Out ports followed by In ports.
- qcom,ports-hstop:	Must be number identifying highest numbered coloum in
			SoundWire Frame, ie the right edge of the Transport sub-frame
			for each port. Values between 0 and 15 are valid
			Out ports followed by In ports.
- qcom,dports-type: 	Must be data one of the following
			0 for reduced port
			1 for simple ports
			2 for full port
= SoundWire devices
Each subnode of the bus represents SoundWire device attached to it.
The properties of these nodes are defined by the individual bindings.

= EXAMPLE
The following example represents a SoundWire controller on DB845c board
which has controller integrated inside WCD934x codec on SDM845 SoC.

soundwire: soundwire@c85 {
	compatible = "qcom,soundwire-v1.3.0";
	reg = <0xc85 0x20>;
	interrupts = <20 IRQ_TYPE_EDGE_RISING>;
	clocks = <&wcc>;
	clock-names = "iface";
	#sound-dai-cells = <1>;
	#address-cells = <1>;
	#size-cells = <0>;
	qcom,dports-type = <0>;
	qcom,dout-ports	= <6>;
	qcom,din-ports	= <2>;
	qcom,ports-sinterval-low = /bits/ 8  <0x07 0x1F 0x3F 0x7 0x1F 0x3F 0x0F 0x0F>;
	qcom,ports-offset1 = /bits/ 8 <0x01 0x02 0x0C 0x6 0x12 0x0D 0x07 0x0A >;
	qcom,ports-offset2 = /bits/ 8 <0x00 0x00 0x1F 0x00 0x00 0x1F 0x00 0x00>;

	/* Left Speaker */
	wsa8810@1{
		....
		reg = <1>;
	};

	/* Right Speaker */
	wsa8810@2{
		....
		reg = <2>;
	};
};
```
