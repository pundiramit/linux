## Documentation/devicetree/bindings/display/panel/lg,sw43408.txt
```
LG model SW43408 DSI display driver

The LG SW43408 is a generic display driver, currently only configured
for use in the Pixel3 phone based on SDM845 chipset.

Required properties:
- compatible: should be "lg,sw43408"
- reg: DSI virtual channel of the peripheral
- vddi-supply: phandle of the regulator that provides the supply voltage
  Power IC supply
- vpnl-supply: phandle of the regulator that provides the supply voltage
  for positive LCD bias
- lab-supply: phandle of the regulator that provides the supply voltage
  for LABIBB
- reset-gpios: phandle of gpio for reset line
  This should be 8mA, gpio can be configured using mux, pinctrl, pinctrl-names
  (active high)
- ports: This device has one video port driven by one DSIs. Their connections
  are modeled using the OF graph bindings specified in
  Documentation/devicetree/bindings/graph.txt.
  - port@0: DSI input port driven by master DSI

Example:

	dsi@ae94000 {
		panel@0 {
		compatible = "lg,sw43408";
		reg = <0>;
		vddi-supply = <&vreg_l14a_1p88>;
		vpnl-supply = <&vreg_l28a_3p0>;
		lab-supply = <&lab_regulator>;

		reset-gpios = <&tlmm 6 GPIO_ACTIVE_HIGH>;

		ports {
			#address-cells = <1>;
			#size-cells = <0>;

			port@0 {
				reg = <0>;
				lg_sw43408_in_0: endpoint {
					remote-endpoint = <&dsi0_out>;
				};
			};
		};
	};
	};
```

## Documentation/devicetree/bindings/display/panel/tianma,nt36672a.txt
```
Tianma model NT36672A DSI display driver

The Tianma NT36672A is a generic display driver, currently only configured
for use in the Poco F1 phone based on SDM845 chipset.

Required properties:
- compatible: should be "tianma,nt36672a"
- reg: DSI virtual channel of the peripheral
- vddio-supply: phandle of the regulator that provides the supply voltage
  Power IC supply
- lab-supply: phandle of the regulator that provides the supply voltage
  for lab LABIBB
- ibb-supply: phandle of the regulator that provides the supply voltage
  for ibb LABIBB
- reset-gpios: phandle of gpio for reset line
  This should be 8mA, gpio can be configured using mux, pinctrl, pinctrl-names
  (active high)
- pinctrl-names: Pinctrl for panel active and suspend
- pinctrl-0: Active pinctrls
- pinctrl-1: Suspend pinctrls
- ports: This device has one video port driven by one DSIs. Their connections
  are modeled using the OF graph bindings specified in
  Documentation/devicetree/bindings/graph.txt.
  - port@0: DSI input port driven by master DSI

Example:

	dsi@ae94000 {
		panel@0 {
		compatible = "tianma,nt36672a";
		reg = <0>;
		vddi0-supply = <&vreg_l14a_1p88>;
		lab-supply = <&lab_regulator>;
		ibb-supply = <&ibb_regulator>;

		reset-gpios = <&tlmm 6 GPIO_ACTIVE_HIGH>;
		
		pinctrl-names = "panel_active", "panel_suspend";
		pinctrl-0 = <&sde_dsi_active>;
		pinctrl-1 = <&sde_dsi_suspend>;

		ports {
			#address-cells = <1>;
			#size-cells = <0>;

			port@0 {
				reg = <0>;
				tianma_nt36672a_in_0: endpoint {
					remote-endpoint = <&dsi0_out>;
				};
			};
		};
	};
	};
```

## Documentation/devicetree/bindings/display/panel/tianma,nt36672a.yaml
```yaml
# SPDX-License-Identifier: GPL-2.0-only OR BSD-2-Clause
%YAML 1.2
---
$id: http://devicetree.org/schemas/display/panel/tianma,nt36672a.yaml#
$schema: http://devicetree.org/meta-schemas/core.yaml#

title: Tianma model NT36672A DSI Panel display driver

maintainers:
  - Sumit Semwal <sumit.semwal@linaro.org>

description: |
  The nt36672a panel from Tianma is a FHD+ LCD display panel with a resolution
  of 1080x2246. It is a video mode DSI panel.

allOf:
  - $ref: panel-common.yaml#

properties:
  compatible:
    const: tianma,nt36672a

  reg:
    description: DSI virtual channel of the peripheral

  reset-gpios:
    description: phandle of gpio for reset line - This should be 8mA, gpio
      can be configured using mux, pinctrl, pinctrl-names (active high)

  vddio-supply:
    description: phandle of the regulator that provides the supply voltage
      Power IC supply

  vddpos-supply:
    description: phandle of the positive boost supply regulator

  vddneg-supply:
    description: phandle of the negative boost supply regulator

  pinctrl-names:
    description: Pinctrl for panel active and suspend

  pinctrl-0:
    description: Active pinctrls

  pinctrl-1:
    description: Suspend pinctrls

  port: true

required:
  - compatible
  - reg
  - vddi0-supply
  - vddpos-supply
  - vddneg-supply
  - reset-gpios
  - pinctrl-names
  - pinctrl-0
  - pinctrl-1
  - port

unevaluatedProperties: false

examples:
  - |+
    #include <dt-bindings/gpio/gpio.h>
    dsi0 {
      #address-cells = <1>;
      #size-cells = <0>;

      panel@0 {
        compatible = "tianma,nt36672a";
        reg = <0>;
        vddi0-supply = <&vreg_l14a_1p88>;
        vddpos-supply = <&lab>;
        vddneg-supply = <&ibb>;

        reset-gpios = <&tlmm 6 GPIO_ACTIVE_HIGH>;

        pinctrl-names = "panel_active", "panel_suspend";
        pinctrl-0 = <&sde_dsi_active>;
        pinctrl-1 = <&sde_dsi_suspend>;

        #address-cells = <1>;
        #size-cells = <0>;
        port {
          tianma_nt36672a_in_0: endpoint {
            remote-endpoint = <&dsi0_out>;
          };
        };
      };
    };

...
```

## Documentation/devicetree/bindings/input/touchscreen/novatek,nt36xxx.yaml
```yaml
# SPDX-License-Identifier: (GPL-2.0-only OR BSD-2-Clause)
%YAML 1.2
---
$id: http://devicetree.org/schemas/input/touchscreen/novatek,nt36xxx.yaml#
$schema: http://devicetree.org/meta-schemas/core.yaml#

title: Novatek NT36xxx series touchscreen controller Bindings

maintainers:
  - TBD

allOf:
  - $ref: touchscreen.yaml#

properties:
  compatible:
    enum:
      - novatek,nt36xxx

  reg:
    enum: [ 0x62 ]

  interrupts:
    maxItems: 1

  reset-gpio:
    maxItems: 1

  vdd-supply:
    description: Power supply regulator for VDD pin

  vio-reg-name:
    description: Power supply regulator on VDD-IO pin

additionalProperties: false

required:
  - compatible
  - reg
  - interrupts

examples:
  - |
    i2c {
      #address-cells = <1>;
      #size-cells = <0>;
      nt36xxx@62 {
        compatible = "novatek,nt36xxx";
        reg = <0x62>;
        interrupt-parent = <&tlmm>;
        interrupts = <45 IRQ_TYPE_EDGE_RISING>;
        reset-gpio = <&tlmm 102 GPIO_ACTIVE_HIGH>;
      };
    };

...
```

## Documentation/devicetree/bindings/power/supply/qcom,pmi8998-charger.yaml
```yaml
# SPDX-License-Identifier: GPL-2.0 OR BSD-2-Clause
%YAML 1.2
---
$id: http://devicetree.org/schemas/power/supply/qcom,smb2.yaml#
$schema: http://devicetree.org/meta-schemas/core.yaml#

title: Qualcomm PMI8998/PM660 Switch-Mode Battery Charger "2"

maintainers:
  - Caleb Connolly <caleb.connolly@linaro.org>

properties:
  compatible:
    enum:
      - qcom,pmi8998-charger

  reg:
    maxItems: 1

  interrupts:
    maxItems: 1

  interrupt-names:
    items:
      - const: usb-plugin

  io-channels:
    items:
      - description: USB in current in uA
      - description: USB in voltage in uV

  io-channel-names:
    items:
      - const: usbin_i
      - const: usbin_v

  monitored-battery:
    description: phandle to the simple-battery node
    $ref: /schemas/types.yaml#/definitions/phandle

required:
  - compatible
  - reg
  - interrupts
  - interrupt-names
  - io-channels
  - io-channel-names
  - monitored-battery

additionalProperties: false

examples:
  - |
    #include <dt-bindings/interrupt-controller/irq.h>

    pmic {
      #address-cells = <1>;
      #size-cells = <0>;
      #interrupt-cells = <4>;

      charger@1000 {
        compatible = "qcom,pmi8998-charger";
        reg = <0x1000>;

        interrupts = <0x2 0x13 0x4 IRQ_TYPE_EDGE_BOTH>;
        interrupt-names = "usb-plugin";

        io-channels = <&pmi8998_rradc 3>,
                      <&pmi8998_rradc 4>;
        io-channel-names = "usbin_i",
                           "usbin_v";
      };
    };
```

## Documentation/devicetree/bindings/regulator/qcom-labibb-regulator.txt
```
Qualcomm's LAB(LCD AMOLED Boost)/IBB(Inverting Buck Boost) Regulator

LAB can be used as a positive boost power supply and IBB can be used as a negative
boost power supply for display panels.

Main node required properties:

- compatible:			Must be:
				"qcom,lab-ibb-regulator"
- #address-cells:		Must be 1
- #size-cells:			Must be 0

LAB subnode required properties:

- reg:				Specifies the SPMI address and size for this peripheral.
- regulator-name:		A string used to describe the regulator.
- interrupts:			Specify the interrupts as per the interrupt
				encoding.
- interrupt-names:		Interrupt names to match up 1-to-1 with
				the interrupts specified in 'interrupts'
				property.

IBB subnode required properties:

- reg:				Specifies the SPMI address and size for this peripheral.
- regulator-name:		A string used to describe the regulator.
- interrupts:			Specify the interrupts as per the interrupt
				encoding.
- interrupt-names:		Interrupt names to match up 1-to-1 with
				the interrupts specified in 'interrupts'
				property.

Example:
	pmi8998_lsid1: pmic@3 {
		qcom-labibb-regulator {
			compatible = "qcom,lab-ibb-regulator";
			#address-cells = <1>;
			#size-cells = <0>;

			lab_regulator: qcom,lab@de00 {
				reg = <0xde00>;
				regulator-name = "lab_reg";

				interrupts = <0x3 0xde 0x0 IRQ_TYPE_EDGE_RISING>;
				interrupt-names = "lab-sc-err";
			};

			ibb_regulator: qcom,ibb@dc00 {
				reg = <0xdc00>;
				regulator-name = "ibb_reg";

				interrupts = <0x3 0xdc 0x2 IRQ_TYPE_EDGE_RISING>;
				interrupt-names = "ibb-sc-err";
			};

		};
	};
```

## Documentation/devicetree/bindings/sound/qcom,wcd934x.txt
```
QCOM WCD9340/9341 Codec Bindings

Qualcomm WCD9340/WCD9341 Codec is a standalone Hi-Fi audio codec IC, supports
Qualcomm Technologies, Inc. (QTI) multimedia solutions, including
the MSM8996, MSM8976, and MSM8956 chipsets. It has in-built
Soundwire controller, interrupt mux. It supports both I2S/I2C and
SLIMbus audio interfaces.

Required properties with SLIMbus Interface:

- compatible:
	Usage: required
	Value type: <stringlist>
	Definition: For SLIMbus interface it should be "slimMID,PID",
		    textual representation of Manufacturer ID, Product Code,
		    shall be in lower case hexadecimal with leading zeroes
		    suppressed.  Refer to slimbus/bus.txt for details.
		    Should be:
		    "slim217,250" for SDM845/SDA845 SoCs with SLIMbus.

- reg
	Usage: required
	Value type: <u32 u32>
	Definition: Should be ('Device index', 'Instance ID')

- interrupts
	Usage: required
	Value type: <prop-encoded-array>
	Definition: Interrupts via WCD INTR1 and INTR2 pins

- interrupt-names:
	Usage: required
	Value type: <String array>
	Definition: Interrupt names of WCD INTR1 and INTR2
	Should be: "intr1", "intr2"

- reset-gpios:
	Usage: required
	Value type: <String Array>
	Definition: Reset gpio line

- slim-ifc-dev:
	Usage: required
	Value type: <phandle>
	Definition: SLIM interface device

- clocks:
	Usage: required
	Value type: <prop-encoded-array>
	Definition: See clock-bindings.txt section "consumers". List of
                three clock specifiers for mclk, mclk2 and slimbus clock.

- clock-names:
	Usage: required
	Value type: <string>
	Definition: Must contain "mclk", "mclk2" and "slimbus" strings.

- vdd-buck-supply:
	Usage: required
	Value type: <phandle>
	Definition: Should contain a reference to the 1.8V buck supply

- vdd-buck-sido-supply:
	Usage: required
	Value type: <phandle>
	Definition: Should contain a reference to the 1.8V SIDO buck supply

- vdd-rx-supply:
	Usage: required
	Value type: <phandle>
	Definition: Should contain a reference to the 1.8V rx supply

- vdd-tx-supply:
	Usage: required
	Value type: <phandle>
	Definition: Should contain a reference to the 1.8V tx supply

- vdd-vbat-supply:
	Usage: Optional
	Value type: <phandle>
	Definition: Should contain a reference to the vbat supply

- vdd-micbias-supply:
	Usage: required
	Value type: <phandle>
	Definition: Should contain a reference to the micbias supply

- vdd-io-supply:
	Usage: required
	Value type: <phandle>
	Definition: Should contain a reference to the 1.8V io supply

- qcom,micbias1-lvl:
	Usage: required
	Value type: <u32>
	Definition: Should be voltage in milli Volts for micbias1 output
	Supported values are in inbetween 1800mV-2850mV

- qcom,micbias2-lvl:
	Usage: required
	Value type: <u32>
	Definition: Should be voltage in milli Volts for micbias2 output
	Supported values are in inbetween 1800mV-2850mV

- qcom,micbias3-lvl:
	Usage: required
	Value type: <u32>
	Definition: Should be voltage in milli Volts for micbias3 output
	Supported values are in inbetween 1800mV-2850mV

- qcom,micbias4-lvl:
	Usage: required
	Value type: <u32>
	Definition: Should be voltage in milli Volts for micbias4 output
	Supported values are in inbetween 1800mV-2850mV

- clock-output-names:
	Usage: required
	Value type: <string>
	Definition: Should be the "mclk", corresponding to name
			of the clk output.

- clock-frequency:
	Usage: required
	Definition: Indicating the frequency of mclk output.

- interrupt-controller:
	Usage: required
	Definition: Indicating that this is a interrupt controller

- #interrupt-cells:
	Usage: required
	Value type: <int>
	Definition: should be 1

- #clock-cells:
	Usage: required
	Value type: <int>
	Definition: should be 0, as there is only one clock out supported.

#sound-dai-cells
	Usage: required
	Value type: <u32>
	Definition: Must be 1

Example:

wcd9340: audio-codec@1{
	compatible = "slim217,250";
	reg  = <1 0>;
	reset-gpios = <&tlmm 64 0>;
	slim-ifc-dev  = <&wcd9340_ifd>;
	vdd-buck-supply = <&vreg_s4a_1p8>;
	vdd-buck-sido-supply = <&vreg_s4a_1p8>;
	vdd-tx-supply = <&vreg_s4a_1p8>;
	vdd-rx-supply = <&vreg_s4a_1p8>;
	vdd-io-supply = <&vreg_s4a_1p8>;
	qcom,micbias1-lvl = <1800>;
	qcom,micbias2-lvl = <1800>;
	qcom,micbias3-lvl = <1800>;
	qcom,micbias4-lvl = <1800>;

	interrupt-parent = <&tlmm>;
	interrupts = <54 IRQ_TYPE_LEVEL_HIGH>;
	interrupt-names  = "intr1";
	interrupt-controller;
	#interrupt-cells = <1>;

	#clock-cells = <0>;
	clock-frequency = <9600000>;
	clock-output-names = "mclk";
	#sound-dai-cells = <1>;

	pinctrl@42 {
		compatible = "qcom,wcd9340-pinctrl";
		gpio-controller;
		#gpio-cells = <2>;
		gpio-ranges = <&wcdpinctrl 0 0 5>;
		reg = <0x42 0x2>;
		...
	};

	soundwire@c85{
		compatible = "qcom,soundwire-v1.3.0";
		reg = <0xc85 0x40>;
		...
	};
};
```

## Documentation/devicetree/bindings/sound/qcom,wsa881x.txt
```
Bindings for Qualcomm WSA8810/WSA8815 Class-D Smart Speaker Amplifier

WSA8810 is a class-D smart speaker amplifier and WSA8815 is a high-output
power class-D smart speaker amplifier. This amplifier uses SoundWire
digital audio as primary interface.

Required properties with SoundWire Interface:

- compatible:		Should be textual representation of SoundWire Enumeration
			address.
			Refer to soundwire/bus.txt for details.
			Should be "sdw10,0217,2010,0" for WSA8810
- sdw-instance-id:	Should be ('Instance ID') from SoundWire Enumeration
		    	address.
			Refer to soundwire/bus.txt for details.
- pd-gpios: 		Should be phandle and gpio pair for
			Powerdown/Shutdown pin.
- #thermal-sensor-cells: Should be 0 

Example:

spkr_left:wsa8810-left{
	compatible = "sdw10,0217,2010,0";
	sdw-instance-id = <1>;
	#thermal-sensor-cells = <0>;
	...
};
```
